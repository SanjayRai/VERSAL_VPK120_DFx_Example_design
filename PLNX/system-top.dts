/*
 * CAUTION: This file is automatically generated by Xilinx.
 * Version: XSCT 
 * Today is: Sat Oct  8 03:17:15 2022
 */


/dts-v1/;
#include "versal.dtsi"
#include "versal-clk.dtsi"
#include "pl.dtsi"
#include "pcw.dtsi"
#include "user_role_0_.dtsi"
/ {
	chosen {
	};
	aliases {
		ethernet0 = &gem0;
		i2c0 = &i2c0;
		i2c1 = &i2c1;
		serial0 = &serial0;
		spi0 = &qspi;
	};
	memorystatic_shell_axi_noc_0: memory@0 {
		device_type = "memory";
		reg = <0x0 0x00000000 0x0 0x80000000>, <0x00000008 0x00000000 0x00000001 0x80000000>;
	};
};
#include "system-user.dtsi"
